## drivers/oplus/oplus_nandswap/Kconfig
```kconfig
config NANDSWAP
	bool "nandswap feature"
	default n
	help
	 nandswap feature

config NANDSWAP_DEBUG
	bool "nandswap debug"
	depends on F2FS_FS
	default n
	help
	 nandswap debug

config DYNAMIC_TUNNING_SWAPPINESS
	bool "dynamic tune swap feature"
	default n
	help
	 dynamic tune swap feature
```
